## boards/shields/scotto9/Kconfig.shield
```kconfig
# No whitespace after the comma or in your keyboard name!
config SHIELD_SCOTTO9
    def_bool $(shields_list_contains,scotto9)
```

## config/west.yml
```yaml
manifest:
  remotes:
    - name: zmkfirmware
      url-base: https://github.com/zmkfirmware
    - name: choyuansu
      url-base: https://github.com/choyuansu
  projects:
    - name: zmk
      remote: zmkfirmware
      revision: main
      import: app/west.yml
    - name: scotto9-zmk
      remote: choyuansu
      revision: main
  self:
    path: config
```
